VERSION ""

NS_ :

BS_:

BU_:

BO_ 790 HYUNDAI_316: 8 Vector__XXX
 SG_ EngineRPM : 16|16@1+ (0.25,0.0) [0|8000] "rpm" Vector__XXX

BO_ 1366 HYUNDAI_556: 8 Vector__XXX
 SG_ EngineRPM : 16|16@1+ (0.25,0.0) [0|8000] "rpm" Vector__XXX

BO_ 1456 HYUNDAI_5B0: 4 Vector__XXX
 SG_ Odometer : 0|24@1+ (0.1,0.0) [0|1000000] "km" Vector__XXX
